## tests/at/commands/lora/testcase.yaml
```yaml
# SPDX-FileCopyrightText: Copyright (c) 2026 RAKwireless
# SPDX-License-Identifier: Apache-2.0

common:
  platform_allow: [native_sim]
  integration_platforms: [native_sim]
  tags: [rzi, at, lora]
tests:
  rzi.at.commands.lora: {}
  rzi.at.commands.lora.dual:
    extra_configs:
      - CONFIG_RZI_LORAWAN=y
      - CONFIG_RZI_LORAWAN_BACKEND_TEST=y
      - CONFIG_RZI_AT_COMMAND_LORAWAN=y
  rzi.at.commands.lora.nvm:
    extra_configs:
      - CONFIG_RZI_LORAWAN=y
      - CONFIG_RZI_LORAWAN_BACKEND_TEST=y
      - CONFIG_RZI_AT_COMMAND_LORAWAN=y
      - CONFIG_RZI_AT_NVM=y
      - CONFIG_FLASH=y
      - CONFIG_SETTINGS_NVS=y
      - CONFIG_MAIN_STACK_SIZE=4096
```

## tests/lorawan/service/Kconfig
```kconfig
# SPDX-FileCopyrightText: Copyright (c) 2026 RAKwireless
# SPDX-License-Identifier: Apache-2.0

source "Kconfig.zephyr"

config RZI_LORAWAN_TEST_FAKE_SUPPORTS_ABP
	bool "Service test fake accepts ABP"
	default y
	help
	  The default matches USP and Zephyr. The no_abp scenario turns this
	  off so set_activation(ABP) returns -RZI_ERR_NOT_SUPPORTED.
```

## tests/system/init/testcase.yaml
```yaml
# SPDX-FileCopyrightText: Copyright (c) 2026 RAKwireless
# SPDX-License-Identifier: Apache-2.0

tests:
  rzi.system.init:
    platform_allow:
      - native_sim/native/64
    integration_platforms:
      - native_sim/native/64
    tags:
      - rzi
      - init
  rzi.system.init.storage:
    platform_allow:
      - native_sim/native/64
    integration_platforms:
      - native_sim/native/64
    extra_configs:
      - CONFIG_RZI_STORAGE=y
    tags:
      - rzi
      - init
      - storage
```

## tests/system/network_mode/testcase.yaml
```yaml
# SPDX-FileCopyrightText: Copyright (c) 2026 RAKwireless
# SPDX-License-Identifier: Apache-2.0

common:
  platform_allow: [native_sim]
  integration_platforms: [native_sim]
  tags: [rzi, network_mode]
tests:
  rzi.system.network_mode: {}
  rzi.system.network_mode.storage:
    extra_configs:
      - CONFIG_RZI_STORAGE=y
  rzi.system.network_mode.nvs:
    extra_configs:
      - CONFIG_RZI_STORAGE=y
      - CONFIG_FLASH=y
      - CONFIG_FLASH_MAP=y
      - CONFIG_NVS=y
      - CONFIG_SETTINGS_NVS=y
      - CONFIG_MAIN_STACK_SIZE=4096
```

## zephyr/Kconfig.power
```kconfig
# SPDX-FileCopyrightText: Copyright (c) 2026 RAKwireless
# SPDX-License-Identifier: Apache-2.0

config RZI_POWER
	bool "RZI power helpers"
	help
	  Service PM locks, a runtime switch for native Zephyr PM locks,
	  and thread waits. Class C, storage writes, and FUOTA transfer
	  or apply take and release PM locks. Class A join/send do not,
	  so the backend can STOP between TX and RX1/RX2. Enable CONFIG_PM
	  in the application to use system PM; Zephyr's policy and the SoC
	  device tree select the actual state. Ordinary CPU idle works
	  without PM.
```
